## dts/bindings/serial/st,stm32-uart.yaml
```yaml
description: STM32 UART

compatible: "st,stm32-uart"

include: uart-controller.yaml

properties:
    reg:
      required: true

    interrupts:
      required: true

    parity:
      required: false
      type: int
      description: |
        Configures the parity of the adapter. Value 0 for none, 1 for odd
        and 2 for even parity.  Default to none if not specified.

    single-wire:
      type: boolean
      required: false
      description: |
        Enable the single wire half-duplex communication.
        Using this mode, TX and RX lines are internally connected and
        only TX pin is used afterwards and should be configured.
        RX/TX conflicts must be handled on user side.

    pinctrl-0:
      type: phandles
      required: false
      description: |
        GPIO pin configuration for serial signals (RX, TX, RTS, CTS).  We expect
        that the phandles will reference pinctrl nodes.

        For example the USART1 would be
           pinctrl-0 = <&usart1_tx_pb6 &usart1_rx_pb7>;
```
